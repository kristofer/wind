## xv6-riscv/esp32s3-idf/main/Kconfig.projbuild
```kconfig
menu "wind ESP32-S3 Options"

config WIND_ALLOC_NEGATIVE_SELFTEST
    bool "Enable allocator negative self-test (intentional double-free)"
    default n
    help
        If enabled, startup runs an intentional double-free after allocator
        self-test PASS, and should trigger allocator panic. Keep disabled for
        normal development.

config WIND_ALLOC_NEGATIVE_INVALID_FREE_SELFTEST
    bool "Enable allocator negative self-test (intentional invalid free)"
    default n
    help
        If enabled, startup calls kfree on an out-of-pool pointer after
        positive self-tests, and should trigger allocator panic. Keep disabled
        for normal development.

config WIND_WIFI_TCP_CONSOLE_ENABLE
    bool "Enable Wi-Fi TCP console bridge"
    default n
    help
        Starts a Wi-Fi station and a simple TCP listener that bridges to the
        wind shell input/output path. Serial console remains active.

if WIND_WIFI_TCP_CONSOLE_ENABLE

config WIND_WIFI_SSID
    string "Wi-Fi SSID"
    default ""

config WIND_WIFI_PASSWORD
    string "Wi-Fi Password"
    default ""

config WIND_TCP_CONSOLE_PORT
    int "TCP console port"
    range 1 65535
    default 2323

endif

endmenu
```
